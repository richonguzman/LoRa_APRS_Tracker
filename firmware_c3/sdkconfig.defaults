## firmware_c3/sdkconfig.defaults
```kconfig
# Target
CONFIG_IDF_TARGET="esp32c3"

# CPU 160 MHz
CONFIG_ESP_DEFAULT_CPU_FREQ_MHZ_160=y

# Watchdog
CONFIG_ESP_TASK_WDT_TIMEOUT_S=10

# WiFi/BLE disabled — S3 handles all wireless, C3 is radio-only (LoRa + GPS)
# Saves ~100-150 KB SRAM + eliminates RF desense on LoRa RX
CONFIG_ESP_WIFI_ENABLED=n
CONFIG_BT_ENABLED=n

# Log level
CONFIG_LOG_DEFAULT_LEVEL_INFO=y
CONFIG_LOG_MAXIMUM_LEVEL_DEBUG=y

# FreeRTOS
CONFIG_FREERTOS_HZ=1000

# Stack sizes
CONFIG_ESP_MAIN_TASK_STACK_SIZE=4096

# Chip revision (C3 eco7 = v1.1, needs max >= 101)
CONFIG_ESP32C3_REV_MIN_FULL=0
CONFIG_ESP32C3_REV_MAX_FULL=199
```
